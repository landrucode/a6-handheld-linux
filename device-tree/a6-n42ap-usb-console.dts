/include/ "a6-n42ap.dts"

/ {
	soc {
		usbphy: phy@36000000 {
			compatible = "apple,s5l8950-usb-phy";
			reg = <0x36000000 0x100>, <0x3f101000 0x1000>,
			      <0x36100e00 4>;
			#phy-cells = <0>;
		};
		usb@36100000 {
			compatible = "apple,s5l8950-dwc2", "snps,dwc2";
			reg = <0x36100000 0x10000>;
			interrupts = <0x0b>;
			phys = <&usbphy>;
			phy-names = "usb2-phy";
			dr_mode = "peripheral";
			maximum-speed = "high-speed";
			status = "okay";
		};
	};
};
